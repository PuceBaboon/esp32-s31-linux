## benchmarks/idf-a2dp-wifi-coex/main/Kconfig.projbuild
```kconfig
menu "S31 A2DP/Wi-Fi coexistence benchmark"

    config BENCH_WIFI_SSID
        string "Wi-Fi station SSID"
        default ""

    config BENCH_WIFI_PASSWORD
        string "Wi-Fi station password"
        default ""

    config BENCH_TCP_PORT
        int "TCP receive benchmark port"
        range 1 65535
        default 3333

    config BENCH_TCP_RCVBUF
        int "TCP socket receive buffer"
        range 4096 65535
        default 32768

endmenu
```

## benchmarks/idf-a2dp-wifi-coex/sdkconfig.defaults
```kconfig
CONFIG_BT_ENABLED=y
CONFIG_BT_CLASSIC_ENABLED=y
CONFIG_BT_A2DP_ENABLE=y
CONFIG_BT_GATTC_ENABLE=n
CONFIG_BT_BLE_SMP_ENABLE=n
CONFIG_BT_BLE_50_FEATURES_SUPPORTED=n
CONFIG_BT_BLE_42_FEATURES_SUPPORTED=y
CONFIG_BTDM_CTRL_MODE_BTDM=y
CONFIG_EXAMPLE_A2DP_SINK_OUTPUT_IDLE=y
CONFIG_EXAMPLE_SSP_ENABLED=y
CONFIG_PARTITION_TABLE_CUSTOM=y
CONFIG_PARTITION_TABLE_CUSTOM_FILENAME="partitions.csv"
CONFIG_ESPTOOLPY_FLASHSIZE_4MB=y
CONFIG_COMPILER_OPTIMIZATION_PERF=y
CONFIG_COMPILER_DISABLE_DEFAULT_ERRORS=y
CONFIG_FREERTOS_USE_TRACE_FACILITY=y
CONFIG_FREERTOS_GENERATE_RUN_TIME_STATS=y
CONFIG_LWIP_SO_RCVBUF=y
```

## buildroot-external/package/btstack-s31/Config.in
```kconfig
config BR2_PACKAGE_BTSTACK_S31
	bool "btstack-s31"
	depends on BR2_USE_MMU
	depends on BR2_TOOLCHAIN_HAS_THREADS
	help
	  Minimal BTstack Classic A2DP sink and BLE GAP/GATT peripheral for the
	  ESP32-S31 direct H4 controller endpoint. The transport is self-contained and does not
	  build or install BlueZ, D-Bus, BlueALSA, or a pairing agent.

	  BTstack is licensed for personal/non-commercial use. Commercial use
	  requires a separate license from BlueKitchen GmbH. This package is
	  therefore intended only for experimental non-commercial images.

config BR2_PACKAGE_BTSTACK_S31_OPTIMIZE_O2
	bool "optimize the BTstack appliance for throughput (-O2)"
	depends on BR2_PACKAGE_BTSTACK_S31
	help
	  Compile only the small BTstack userspace appliance with -O2 for
	  controlled CPU/size A/B measurements. The default remains -Os until
	  the on-board A2DP acceptance run proves a net benefit.
```

## firmware/lp/sdkconfig.defaults
```kconfig
CONFIG_IDF_TARGET="esp32s31"
CONFIG_ULP_COPROC_ENABLED=y
CONFIG_ULP_COPROC_TYPE_LP_CORE=y
CONFIG_ULP_COPROC_RESERVE_MEM=8192
```

## tools/hil/esp32s31-idf-spi-baseline/sdkconfig.defaults
```kconfig
CONFIG_ESPTOOLPY_FLASHSIZE_16MB=y
CONFIG_ESPTOOLPY_FLASHMODE_DIO=y
CONFIG_ESPTOOLPY_FLASHFREQ_80M=y
CONFIG_ESP_CONSOLE_UART_DEFAULT=y
CONFIG_ESP_CONSOLE_UART_BAUDRATE=115200
```
